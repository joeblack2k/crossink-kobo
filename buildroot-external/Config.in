## buildroot-external/configs/crossink_kobo_glo_hd_defconfig
```kconfig
BR2_arm=y
BR2_cortex_a9=y
BR2_ARM_ENABLE_NEON=y
BR2_ARM_ENABLE_VFP=y
BR2_ARM_FPU_VFPV3=y
BR2_TOOLCHAIN_BUILDROOT_MUSL=y
BR2_TOOLCHAIN_BUILDROOT_CXX=y
BR2_EXTRA_GCC_CONFIG_OPTIONS="--disable-analyzer"
BR2_CCACHE=y
BR2_PACKAGE_HOST_LINUX_HEADERS_CUSTOM_6_19=y
BR2_TARGET_GENERIC_HOSTNAME="crossink-n437"
BR2_TARGET_GENERIC_ISSUE="CrossInk Kobo Glo HD bring-up"
BR2_TARGET_GENERIC_GETTY_PORT="ttymxc0"
BR2_SYSTEM_BIN_SH_BUSYBOX=y
BR2_ROOTFS_OVERLAY="$(BR2_EXTERNAL_CROSSINK_KOBO_PATH)/board/kobo-glo-hd/rootfs-overlay"
BR2_ROOTFS_POST_BUILD_SCRIPT="$(BR2_EXTERNAL_CROSSINK_KOBO_PATH)/board/kobo-glo-hd/post-build.sh"
BR2_LINUX_KERNEL=y
BR2_LINUX_KERNEL_CUSTOM_GIT=y
BR2_LINUX_KERNEL_CUSTOM_REPO_URL="https://github.com/akemnade/linux.git"
BR2_LINUX_KERNEL_CUSTOM_REPO_VERSION="ccddaba42e0abafbce84cc2243cbe0c98d400944"
BR2_LINUX_KERNEL_PATCH="$(BR2_EXTERNAL_CROSSINK_KOBO_PATH)/board/kobo-glo-hd/kernel-patches"
BR2_LINUX_KERNEL_DEFCONFIG="kobo"
BR2_LINUX_KERNEL_CONFIG_FRAGMENT_FILES="$(BR2_EXTERNAL_CROSSINK_KOBO_PATH)/board/kobo-glo-hd/linux.fragment"
BR2_LINUX_KERNEL_DTS_SUPPORT=y
BR2_LINUX_KERNEL_CUSTOM_DTS_PATH="$(BR2_EXTERNAL_CROSSINK_KOBO_PATH)/board/kobo-glo-hd/dts/imx6sl-crossink-kobo-glo-hd.dts"
BR2_LINUX_KERNEL_NEEDS_HOST_OPENSSL=y
BR2_LINUX_KERNEL_INSTALL_TARGET=y
BR2_PACKAGE_BUSYBOX_SHOW_OTHERS=y
BR2_PACKAGE_DROPBEAR=y
BR2_PACKAGE_DROPBEAR_DISABLE_REVERSEDNS=y
BR2_PACKAGE_DROPBEAR_SMALL=y
BR2_PACKAGE_CA_CERTIFICATES=y
BR2_PACKAGE_OPENSSL=y
BR2_PACKAGE_LIBCURL=y
# The shared CrossInk HTTP adapter is used by the Kobo build too.  Its native
# simulator-compatible implementation invokes the curl client for redirects,
# Basic authentication and TLS validation, so shipping only libcurl leaves
# OPDS and other downloads as a guaranteed runtime failure.
BR2_PACKAGE_LIBCURL_CURL=y
BR2_PACKAGE_LIBCURL_OPENSSL=y
BR2_PACKAGE_WPA_SUPPLICANT=y
BR2_PACKAGE_WPA_SUPPLICANT_CLI=y
BR2_PACKAGE_WPA_SUPPLICANT_PASSPHRASE=y
BR2_PACKAGE_HOSTAPD=y
BR2_PACKAGE_DNSMASQ=y
BR2_PACKAGE_IW=y
BR2_PACKAGE_LINUX_FIRMWARE=y
BR2_PACKAGE_LINUX_FIRMWARE_CYPRESS_CYW43XXX=y
BR2_PACKAGE_WIRELESS_REGDB=y
BR2_PACKAGE_CROSSINK_FBINK=y
BR2_PACKAGE_CROSSINK_KOBO_PLATFORM=y
BR2_PACKAGE_CROSSINK_KOBO_APP=y
BR2_TARGET_ROOTFS_TAR=y
BR2_PACKAGE_HOST_UBOOT_TOOLS=y
```

## buildroot-external/package/crossink-fbink/Config.in
```kconfig
config BR2_PACKAGE_CROSSINK_FBINK
	bool "CrossInk FBInk backend"
	depends on BR2_USE_MMU
	help
	  Build the pinned GPLv3+ FBInk static backend for the Kobo i.MX EPDC.
	  CrossInk-Kobo uses it for framebuffer discovery and safe full/partial
	  refreshes; source and licensing are bundled with every release.
```

## buildroot-external/package/crossink-kobo-app/Config.in
```kconfig
config BR2_PACKAGE_CROSSINK_KOBO_APP
	bool "CrossInk Kobo application"
	depends on BR2_TOOLCHAIN_GCC_AT_LEAST_10
	depends on BR2_INSTALL_LIBSTDCPP
	select BR2_PACKAGE_CROSSINK_KOBO_PLATFORM
	select BR2_PACKAGE_OPENSSL
	help
	  Build the CrossInk reader and activities against the Kobo/Linux HAL.
```

## buildroot-external/package/crossink-kobo-platform/Config.in
```kconfig
config BR2_PACKAGE_CROSSINK_KOBO_PLATFORM
	bool "CrossInk Kobo Linux platform"
	depends on BR2_TOOLCHAIN_GCC_AT_LEAST_10
	select BR2_PACKAGE_CROSSINK_FBINK
	select BR2_PACKAGE_LIBDRM
	help
	  Build the isolated Kobo/Linux display HAL and hardware smoke tools.
```
